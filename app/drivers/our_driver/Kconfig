## app/drivers/our_driver/Kconfig
```kconfig
config OUR_DRIVER
    bool "Our Driver"
    default y

config OUR_DRIVER_SHELL
    bool "Our Driver shell support"
    select SHELL
```

## boards/esp32c3_vlad_test/Kconfig.esp32c3_vlad_test
```kconfig
# Copyright 2024 Nordic Semiconductor ASA
# SPDX-License-Identifier: Apache-2.0

config BOARD_ESP32C3_VLAD_TEST
	select SOC_ESP32C3_FH4
```

## boards/esp32c3_vlad_test/board.yml
```yaml
board:
  name: esp32c3_vlad_test
  full_name: ESP32C3 VLAD TEST (0.42 OLED)
  vendor: 01space-sdevelop
  socs:
  - name: esp32c3
```

## boards/esp32c3_vlad_test2/Kconfig
```kconfig
# Required for k_malloc() to work/compile
config HEAP_MEM_POOL_ADD_SIZE_BOARD
	int
	default 4096

config BOARD_ESP32C3_VLAD_TEST2
	select BOARD_EARLY_INIT_HOOK
```

## boards/esp32c3_vlad_test2/board.yml
```yaml
board:
  name: esp32c3_vlad_test2
  full_name: ESP32C3 VLAD TEST2 (from scratch, based on 0.42 OLED)
  vendor: sdevelop
  socs:
  - name: esp32c3
```
