## CMakeLists.txt
```
cmake_minimum_required(VERSION 3.20.0)

# Add explicitly app.overlay file to the build.
# This is required because app already defined esp32c3_042_oled board overlay file.
if (${BOARD} MATCHES "^esp32c3_042_oled")
    message(NOTICE "Building for ${BOARD} board, adding app.overlay via EXTRA_DTC_OVERLAY_FILE")
    set (EXTRA_DTC_OVERLAY_FILE "${CMAKE_CURRENT_SOURCE_DIR}/app.overlay")
endif()

find_package(Zephyr REQUIRED)
project(my_zephyr_app)

target_sources(app PRIVATE src/main.cpp)
```

## Kconfig
```
source "Kconfig.zephyr"

# Zephyr-course configuration options

config EXPERT
	bool "Show expert options"
	default n

menuconfig LED_SUBSYSTEM
	bool "LED Subsystem"
	default y

if LED_SUBSYSTEM

config APP_HEARTBEAT_PERIOD_MS
	int "Set heartbeat LED period (ms)"
	default 500
	range 100 2000

choice
	prompt "LED blink sleep time"
	default BLINK_SLEEP_1000MS

config BLINK_SLEEP_250MS
	bool "0.25s (ultra fast)"

config BLINK_SLEEP_500MS
	bool "0.5s (fast)"

config BLINK_SLEEP_1000MS
	bool "1s (medium)"

config BLINK_SLEEP_2000MS
	bool "2s (slow)"

endchoice

config BLINK_SLEEP_TIME_MS
	int
	default 250 if BLINK_SLEEP_250MS
	default 500 if BLINK_SLEEP_500MS
	default 1000 if BLINK_SLEEP_1000MS
	default 2000 if BLINK_SLEEP_2000MS

menuconfig LED_SETTINGS_ADV
	bool "Advanced LED settings"
	default n

if LED_SETTINGS_ADV

config LED_BRIGHTNESS
	int "LED brightness (0-100)"
	default 100
	range 0 100

config LED_FADE_DURIATION
	int "LED fade duration (ms)"
	default 500
	range 0 5000

menu "Expert settings"
	visible if EXPERT

config LED_DUBUG
	bool "Enable LED debugging"
	default n

config CUSTOM_BLINK_PATTERN
	bool "Custom blink pattern"
	default n
endmenu

endif # LED_SETTINGS_ADV

endif # LED_SUBSYSTEM
```

## prj.conf
```kconfig
CONFIG_GPIO=y
CONFIG_LOG=y
CONFIG_OUR_DRIVER_SHELL=y
```

## app.overlay
```dts
/ {
    aliases {
        app-led = &led0;
    };
    our_driver0: our_driver {
        compatible = "our,driver";
        status = "okay";
    };
};
```

## boards/esp32c3_042_oled.overlay
```dts
/ {
        aliases {
                led0 = &led0;
        };

        leds {
                compatible = "gpio-leds";
                led0: led_0 {
                        gpios = <&gpio0 8 GPIO_ACTIVE_LOW>; // GPIO8
                        label = "LED0";
                };
        };
};
```

## src/main.cpp
```c
#include <zephyr/drivers/gpio.h>
#include <zephyr/kernel.h>
#include <zephyr/logging/log.h>

#if defined(CONFIG_LED_SUBSYSTEM)
#define SLEEP_TIME_MS CONFIG_APP_HEARTBEAT_PERIOD_MS
#else
#define SLEEP_TIME_MS 500
#endif

/* The devicetree node identifier for the "app_led" alias. */
#define LED_NODE DT_ALIAS(app_led)

static const struct gpio_dt_spec led = GPIO_DT_SPEC_GET(LED_NODE, gpios);

LOG_MODULE_REGISTER(main, LOG_LEVEL_INF);

int main(void)
{
    bool led_state = true;

    if (!gpio_is_ready_dt(&led)) return 0;

    if (gpio_pin_configure_dt(&led, GPIO_OUTPUT_ACTIVE) < 0) return 0;

    LOG_INF("LED_SUBSYSTEM: %s, SLEEP_TIME_MS: %d ms",
        IS_ENABLED(CONFIG_LED_SUBSYSTEM) ? "enabled" : "disabled", SLEEP_TIME_MS);

    while (1) {
        if (gpio_pin_toggle_dt(&led) < 0) return 0;

        led_state = !led_state;
        LOG_INF("LED state: %s", led_state ? "ON" : "OFF");
        k_msleep(SLEEP_TIME_MS);
    }
    return 0;
}
```
